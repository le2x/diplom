#include <stdio.h>
#include <avr/io.h>
#include <avr/interrupt.h>
#include <util/delay.h>

//переменная счетчик
volatile unsigned long int0_cnt = 0;

//=======================UART=================

void init_UART(void)
{
	//	Установка скорости 9600
	UBRRH=0;	//	UBRR=f/(16*band)-1 f=8000000Гц band=9600,
	UBRRL=51;	//	нормальный асинхронный двунаправленный режим работы
	
	//			RXC			-	завершение приёма
	//			|TXC		-	завершение передачи
	//			||UDRE 		-	отсутствие данных для отправки
	//			|||FE		-	ошибка кадра
	//			||||DOR		-	ошибка переполнение буфера
	//			|||||PE		-	ошибка чётности
	//			||||||U2X	-	Двойная скорость
	//			|||||||MPCM	-	Многопроцессорный режим
	//			76543210
	UCSRA=0b00000000;

	//			RXCIE		-	прерывание при приёме данных
	//			|TXCIE		-	прерывание при завершение передачи
	//			||UDRIE		-	прерывание отсутствие данных для отправки
	//			|||RXEN		-	разрешение приёма
	//			||||TXEN	-	разрешение передачи
	//			|||||UCSZ2	-	UCSZ0:2 размер кадра данных
	//			||||||RXB8	-	9 бит принятых данных
	//			|||||||TXB8	-	9 бит переданных данных
	//			76543210
	UCSRB=0b00011000;	//	разрешен приём и передача по UART

	//			URSEL		-	всегда 1
	//			|UMSEL		-	режим:1-синхронный 0-асинхронный
	//			||UPM1		-	UPM0:1 чётность
	//			|||UPM0		-	UPM0:1 чётность
	//			||||USBS	-	топ биты: 0-1, 1-2
	//			|||||UCSZ1	-	UCSZ0:2 размер кадра данных
	//			||||||UCSZ0	-	UCSZ0:2 размер кадра данных
	//			|||||||UCPOL-	в синхронном режиме - тактирование
	//			76543210
	UCSRC=0b10000110;	//	8-битовая посылка
}

void send_Uart(unsigned char c)//	Отправка байта
{
	while(!(UCSRA&(1<<UDRE)))	//	Устанавливается, когда регистр свободен
	{}
	UDR = c;
}

void send_Uart_str(const char *s)//	Отправка строки
{
	while (*s != 0) send_Uart(*s++);
}

void send_int_Uart(unsigned int c)//	Отправка числа от 0000 до 9999
{
	unsigned char temp;
	c=c%10000;
	temp=c/100;
	send_Uart(temp/10+'0');
	send_Uart(temp%10+'0');
	temp=c%100;
	send_Uart(temp/10+'0');
	send_Uart(temp%10+'0');
}

//=========================PWM=====================
void init_pwm()
{
	TCCR1A = (1<<COM1A1) | (1<<WGM10);
	TCCR1B = (1<<CS10); //предделитель = 1
	OCR1A = 0x00; //начальное состояние 0
}

//=======================ExtInt====================

//настройка внешнего прерывния INT0
/*
void int0_init( void )
{
	//настраиваем на срабатывание INT0 по переднему фронту
	MCUCR |= (1<<ISC00);
	//разрешаем внешнее прерывание INT0
	GICR |= (1<<INT0);
}



//функция обработчик внешнего прерывания INT0
ISR( INT0_vect )
{
	int0_cnt++;
	PORTC = 0b00000001;			//	Включаем диод PC0 = 1 = Vcc
}
*/


int main( )
{
	//временная переменная
	unsigned long tmp;
	int i = 0;
	DDRC = 0xff;
	init_pwm();

	//int0_init();
	
	init_UART();					//	инициализация UART
	_delay_ms(1000);				//	задержка 1c
	send_Uart_str("alex-exe.ru");	//	отправка строки
	send_Uart(13);					//	перенос строки
	send_int_Uart(2013);			//	отправка числа
	send_Uart(13);

	sei();

	while(1) {
		
		if(i<255){
			OCR1A++;
			i++;
			_delay_ms(250);
			}else{
			OCR1A = 0x00;
			i=0;
		}
		
		//на время копирования значения счетчика запрещаем прерывания
		/*tmp = int0_cnt;
		//разрешаем прерывания
		send_Uart_str( "int0_cnt = ");
		send_int_Uart(int0_cnt);
		send_Uart(13);*/
		//пауза 1 секунда
		PORTC = 0b00000000;			
	}
	return 0;
}
